## config/west.yml
```yaml
manifest:
  defaults:
    remote: urob
    revision: v0.3

  remotes:
    - name: zmkfirmware
      url-base: https://github.com/zmkfirmware
    - name: urob
      url-base: https://github.com/urob
    - name: gpeye
      url-base: https://github.com/GPeye

  projects:
    - name: zmk
      remote: zmkfirmware
      import: app/west.yml

    - name: zephyr
      remote: zmkfirmware
      revision: v3.5.0+zmk-fixes
      import:
        name-allowlist:
          - cmsis
          - hal_nordic
          - lvgl
          - tinycrypt
          - nanopb

    - name: zmk-helpers
    - name: zmk-leader-key
    - name: zmk-adaptive-key
    - name: hammerbeam-slideshow
      remote: gpeye
      revision: main

  self:
    path: boards
```
